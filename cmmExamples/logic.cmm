a = 5 && 1
b = 0 || 7
c = 2 && 0
d = 0 || 0
print a, b, c, d