a = 3
b = 4
print a + b, a * b, b - a, a < b
print (a + b) * 2