a = 0
b = 1
if (a) if (b) print 1 else print 2
print 3