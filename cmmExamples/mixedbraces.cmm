x = 5
if (x > 3) {
    print 1
} else print 0
if (x < 3) print 1 else {
    print 0
}