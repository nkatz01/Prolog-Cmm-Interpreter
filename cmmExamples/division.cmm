a = 7 / 2
b = 0 - 7
c = b / 2
d = b % 3
e = 7 % 3
print a, c, d, e